## base_external/package/ldd/Config.in
```kconfig
config BR2_PACKAGE_LDD
	bool "ldd"
	depends on BR2_LINUX_KERNEL
	help
	  Linux Device Drivers (ldd) package for misc-modules and scull
	  kernel modules from the LDD3 examples.
```
